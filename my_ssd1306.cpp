/*
Functions used for displaying on OLED ssd1306 128x64 pixel screen
Some are the most used functions:

********** void initializeDisplay(); **************
Must run once durinig setup to initialize

**********  printChar(uint16_t);     *************
Print a single character with single quotes. 
ex  printChar('h');
*********** clearDisplay(void);   *************
Clears display by writing over the whole screen.
Takes a lot of time
Brings cursor back to 0,0
**************** writeString (uint16_t *c)  *********
Writes an array of characters using double quotes
Ex. writeString("Now is the time...");

*********** setLocation(uint16_t,uint16_t)* *******
Brings cursor to specified location
screen dimenstions:  0,0  upper left
                     127,7 lower right
    
This set of commands will give space for printing the 'h' in
the lowest, rightmost space.	
	setLocation(122,7);
    printChar('h');
*/

#include <stdio.h>

#include <inttypes.h>
#include <my_ssd1306.h>
#include <i2c_master.h>

/*
**  WHO_AM_I Device ID Register
*/
#define child_id          0x3C
#define SYSMOD                0x0B
//***** ssd Commands and data *************

#define SSD1306_LCDWIDTH      128
#define SSD1306_LCDHEIGHT      64
#define SSD1306_SETCONTRAST   0x81
#define SSD1306_DISPLAYALLON_RESUME 0xA4
#define SSD1306_DISPLAYALLON 0xA5
#define SSD1306_NORMALDISPLAY 0xA6
#define SSD1306_INVERTDISPLAY 0xA7
#define SSD1306_DISPLAYOFF 0xAE
#define SSD1306_DISPLAYON 0xAF
#define SSD1306_SETDISPLAYOFFSET 0xD3
#define SSD1306_SETCOMPINS 0xDA
#define SSD1306_SETVCOMDETECT 0xDB
#define SSD1306_SETDISPLAYCLOCKDIV 0xD5
#define SSD1306_SETPRECHARGE 0xD9
#define SSD1306_SETMULTIPLEX 0xA8
#define SSD1306_SETLOWCOLUMN 0x00
#define SSD1306_SETHIGHCOLUMN 0x10
#define SSD1306_SETSTARTLINE 0x40
#define SSD1306_MEMORYMODE 0x20
#define SSD1306_COLUMNADDR 0x21
#define SSD1306_PAGEADDR   0x22
#define SSD1306_COMSCANINC 0xC0
#define SSD1306_COMSCANDEC 0xC8
#define SSD1306_SEGREMAP 0xA0
#define SSD1306_CHARGEPUMP 0x8D
#define SSD1306_EXTERNALVCC 0x1
#define SSD1306_SWITCHCAPVCC 0x2

/************** Global Variables ************************/
uint8_t asciiChar[]= {
	0x00, 0x00, 0x00, 0x00, 0x00,
	0x3E, 0x5B, 0x4F, 0x5B, 0x3E,
	0x3E, 0x6B, 0x4F, 0x6B, 0x3E,
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	0x00, 0x00, 0x00, 0x00, 0x00 
};

void  ssd1306_command(uint8_t c) {
	uint8_t control = 0x00; // for command. some use 0X00 other examples use 0X80
	//I2C0WriteRegister(child_id, control, c); // Writes 0x00 to data config register (0x0E).  This is 2g range, no high pass 
	i2c_writeByteReg(child_id,control,c);
}

void  ssd1306_data(uint8_t c) {
    //I2C0WriteRegister(child_id, 0x40, c); // Writes 0x00 to data config register (0x0E).  This is 2g range, no high pass data filter
    i2c_writeByteReg(child_id,0x40,c);
}

// Used when doing Horizontal or Vertical Addressing
void setColAddress(uint16_t xCol) {
    if (xCol > (SSD1306_LCDWIDTH-1)) return;
    ssd1306_command(SSD1306_COLUMNADDR); // 0x21 COMMAND
    ssd1306_command(xCol); // Column start address
    ssd1306_command(SSD1306_LCDWIDTH-1); // Column end address  0 thru 127
}

// Used when doing Horizontal or Vertical Addressing
void setPageAddress(uint16_t yPage) {
    if (yPage > (SSD1306_LCDHEIGHT/8-1)) return;
    ssd1306_command(SSD1306_PAGEADDR); // 0x22 COMMAND
    ssd1306_command(yPage); // Start Page address
    ssd1306_command((SSD1306_LCDHEIGHT/8)-1);// End Page address 0-7   (0 thru(64/8)-1) 
}

// Transfers the local buffer to the CGRAM in the SSD1306
void transferBuffer(uint8_t *p, uint16_t size,uint8_t xCol,uint8_t yPage) {
    uint16_t j = 0;
 
    // set the Column and Page addresses to 0,0
    setColAddress(xCol);
    setPageAddress(yPage);
    for (j = 0; j < size; j++) {
        i2c_writeReg(child_id,0x40,*p,1);
        //I2C0WriteRegister(child_id, 0x40, *p); // Writes 0x00 to data config register (0x0E).  This is 2g range, no high pass data filter
        p++;
    }
}

void clearDisplay(void) {
	uint16_t j=0;
    // set the Column and Page addresses to 0,0
    setColAddress(0);
    setPageAddress(0);
    
    for (j = 0; j < 1024; j++) {
        //I2C0WriteRegister(child_id, 0x40, 0); // 
        i2c_writeByteReg(child_id,0x40,0);
    }
}

//  Set screen location from 0,0 upper left to 127,7 lower right
void setLocation(uint16_t xCol,uint16_t yPage) {
    // set the Column and Page addresses to 0,0
    setColAddress(xCol);
    setPageAddress(yPage);
}

/*  This function will transfer the shape of each ascii character to the display.  Each character
 * is a matrix of points 5x7 dots,  The pattern for each character is given in the global array  
 * asciiChar[].  Ex. the pattern for a '0' = 48 = 0x30 is the row with values
 * 
 * 	0x3E, 0x51, 0x49, 0x45, 0x3E,  map these binary values vertically and you get an ascii 0
 *   -     x     x     x     -
 *   x     -     -     -     x
 *   x     x     -     -     x
 *   x     -     x     -     x
 *   x     -     -     x     x
 *   x     -     -     -     x
 *   -     x     x     x     -
 *     */

void printChar(uint8_t c) {
	uint16_t j = 0,ct;
    ct = 5*c;
    //I2C0WriteRegister(child_id, 0x40, 0); //some space before and after each character
    i2c_writeByteReg(child_id, 0x40, 0);
    for (j = 0; j < 5; j++) {
        //I2C0WriteRegister(child_id, 0x40, asciiChar[ct]);
        i2c_writeByteReg(child_id, 0x40, asciiChar[ct]);
		ct++;
    }
      i2c_writeByteReg(child_id, 0x40, 0);
	  //I2C0WriteRegister(child_id, 0x40, 0); //some space before and after each character
}

// init according to SSD1306 data sheet
void  initSSD1306(void) {

	//init_I2C0();  //  C8 (SCL) C9 (SDA) are the oled
     i2c_init();
    // Init sequence for 128x64 OLED module
    ssd1306_command(SSD1306_DISPLAYOFF);                    // 0xAE

    ssd1306_command(SSD1306_SETDISPLAYCLOCKDIV);            // 0xD5
    ssd1306_command(0x80);                 // the suggested ratio 0x80
   
    ssd1306_command(SSD1306_SETMULTIPLEX);                  // 0xA8
    ssd1306_command(0x3F);
   
    ssd1306_command(SSD1306_SETDISPLAYOFFSET);              // 0xD3
    ssd1306_command(0x0);                                   // no offset
   
    ssd1306_command(SSD1306_SETSTARTLINE);// | 0x0);        // line #0
   
    ssd1306_command(SSD1306_CHARGEPUMP);                    // 0x8D
    ssd1306_command(0x14);  // using internal VCC
   
    ssd1306_command(SSD1306_MEMORYMODE);                    // 0x20
    ssd1306_command(0x00);          // 0x00 horizontal addressing
   
    ssd1306_command(SSD1306_SEGREMAP | 0x1); // rotate screen 180
   
    ssd1306_command(SSD1306_COMSCANDEC); // rotate screen 180
   
    ssd1306_command(SSD1306_SETCOMPINS);                    // 0xDA
    ssd1306_command(0x12);
   
    ssd1306_command(SSD1306_SETCONTRAST);                   // 0x81
    ssd1306_command(0xCF);
   
    ssd1306_command(SSD1306_SETPRECHARGE);                  // 0xd9
    ssd1306_command(0xF1);
   
    ssd1306_command(SSD1306_SETVCOMDETECT);                 // 0xDB
    ssd1306_command(0x40);
   
    ssd1306_command(SSD1306_DISPLAYALLON_RESUME);           // 0xA4
   
    ssd1306_command(SSD1306_NORMALDISPLAY);                 // 0xA6
 
    ssd1306_command(SSD1306_DISPLAYON);                     //switch on OLED

}
 
void writeString(uint8_t *c) {
    while (*c) {
        printChar(*c);
        c++;
	}
}

void printHexByte(uint8_t num) {
	uint8_t temp = 0;
	temp = num>>4;
	if (temp<10)
        printChar(temp+'0');
	else 
        printChar(temp+'7');  //  or 'A'-10
	temp = 0x0f&num;
	if(temp<10)
        printChar(temp+'0');
	else 
        printChar(temp+'7');
}

void printHexWord(uint16_t num) {
	uint8_t temp=0;
	temp = num>>8;
	printHexByte(temp);
	temp = num&0x00ff;
	printHexByte(temp);
}

void printMem(uint16_t loc) {
	uint16_t temp1;
	temp1 = *(uint16_t *)loc; //prints out the location = value
    printHexWord(temp1);
	return;
}

